## board/digilent/genesys2/Kconfig
```kconfig
if TARGET_GENESYS2

config SYS_BOARD
    default "genesys2"

config SYS_VENDOR
    default "digilent"

config SYS_CONFIG_NAME
    default "genesys2"

endif
```

## configs/genesys2_defconfig
```kconfig
# CPU Config

CONFIG_RISCV=y
CONFIG_ARCH_RV64I=y
CONFIG_CPU=y
CONFIG_CPU_RISCV=y
CONFIG_RISCV_SMODE=y

# Basic U-Boot configuration
CONFIG_SYS_MALLOC_LEN=0x800000
CONFIG_SYS_MALLOC_F_LEN=0x4000
CONFIG_DM=y


# 對應的板子 include/configs/genesys2.h

CONFIG_TARGET_GENESYS2=y
CONFIG_SYS_CONFIG_NAME="genesys2"
CONFIG_OF_EMBED=y
CONFIG_DEFAULT_DEVICE_TREE="chipyard.fpga.genesys2.GENESYS2FPGATestHarness.RocketGENESYS2Config"

# DDR / 起始位址 - 避免與 OpenSBI 衝突
# OpenSBI 佔用 0x80000000-0x8003ffff 所以調整 U-Boot 位置
CONFIG_SYS_INIT_RAM_ADDR=0x80080000		
CONFIG_SYS_INIT_RAM_SIZE=0x00020000
CONFIG_TEXT_BASE=0x80200000
CONFIG_SYS_UBOOT_START=0x80200000
CONFIG_SYS_LOAD_ADDR=0x80400000
CONFIG_SYS_INIT_SP_ADDR=0x8009FE00


# Console (SiFive UART)
CONFIG_SERIAL=y
CONFIG_DM_SERIAL=y
CONFIG_SIFIVE_SERIAL=y
CONFIG_BAUDRATE=115200

# debug uart
CONFIG_DEBUG_UART=y
CONFIG_DEBUG_UART_BASE=0x64000000
CONFIG_DEBUG_UART_CLOCK=50000000
CONFIG_DEBUG_UART_SHIFT=0
CONFIG_DEBUG_UART_ANNOUNCE=y


# MMC/SD over SPI
CONFIG_SPI=y
CONFIG_DM_SPI=y
CONFIG_SPI_SIFIVE=y  

CONFIG_MMC=y
CONFIG_MMC_WRITE=y
CONFIG_MMC_SPI=y
CONFIG_MMC_BROKEN_CD=y
CONFIG_DM_MMC=y
CONFIG_CMD_MMC=y

# Filesystem
CONFIG_FS_FAT=y
CONFIG_FAT_WRITE=y
CONFIG_FS_EXT4=y
CONFIG_EXT4_WRITE=y
CONFIG_CMD_FS_GENERIC=y

# boot command
CONFIG_USE_BOOTCOMMAND=y
CONFIG_BOOTCOMMAND="mmc dev 0; fatload mmc 0:1 0x80400000 Image; fatload mmc 0:1 0x88000000 system.dtb; booti 0x80400000 - 0x88000000"
CONFIG_AUTOBOOT=y
CONFIG_BOOTDELAY=2

# 0822
CONFIG_TIMER=y
CONFIG_RISCV_TIMER=y
#CONFIG_TIMER_EARLY=y
CONFIG_IRQ=y
CONFIG_CMODEL_MEDANY=y

# Debug options
CONFIG_LOG=y
CONFIG_LOG_DEFAULT_LEVEL=7
CONFIG_LOGLEVEL=7
CONFIG_LOG_ERROR_RETURN=y
CONFIG_LOG_CONSOLE=y
CONFIG_DM_DEBUG=y
CONFIG_DM_WARN=y
CONFIG_CMD_DM=y
CONFIG_CMD_LOG=y
CONFIG_DM_DEVICE_REMOVE=y
CONFIG_DM_STATS=y
CONFIG_MISC=y
CONFIG_CMD_FAT=y
CONFIG_CMD_EXT4=y
```
